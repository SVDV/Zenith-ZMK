## config/west.yml
```yaml
manifest:
  remotes:
  - name: zmkfirmware
    url-base: https://github.com/zmkfirmware
  - name: svdv
    url-base: https://github.com/SVDV
  projects:
  - name: zmk
    remote: zmkfirmware
    revision: main
    import: app/west.yml
  - name: prospector-zmk-module
    remote: svdv
    revision: feat/swipe-views
    path: modules/prospector-zmk-module
  self:
    path: config
```

## diag/Kconfig
```kconfig
config ZENITH_QSPI_DIAG
	bool "Log the external QSPI flash state every 10 s (battery-drain diagnostic)"
```
